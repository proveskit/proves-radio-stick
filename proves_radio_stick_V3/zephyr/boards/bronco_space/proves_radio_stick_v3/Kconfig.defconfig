## proves_radio_stick_V3/zephyr/boards/bronco_space/proves_radio_stick_v3/Kconfig.proves_radio_stick_v3
```kconfig
# SPDX-License-Identifier: Apache-2.0

config BOARD_PROVES_RADIO_STICK_V3
	select SOC_STM32U585XX
```

## proves_radio_stick_V3/zephyr/boards/bronco_space/proves_radio_stick_v3/board.yml
```yaml
board:
  name: proves_radio_stick_v3
  full_name: PROVES Radio Stick V3
  vendor: bronco_space
  socs:
    - name: stm32u585xx
```
